## yocto/build/conf/bblayers.conf
```bitbake
# POKY_BBLAYERS_CONF_VERSION is increased each time build/conf/bblayers.conf
# changes incompatibly
POKY_BBLAYERS_CONF_VERSION = "2"

BBPATH = "${TOPDIR}"
BBFILES ?= ""
BSPDIR = "/home/linuxarze/Documents/yocto-hc/HackCarpathia/yocto"

BBLAYERS = " \
  ${BSPDIR}/poky/meta \
  ${BSPDIR}/poky/meta-poky \
  ${BSPDIR}/meta-openembedded/meta-oe \
  ${BSPDIR}/meta-openembedded/meta-python \
  ${BSPDIR}/meta-raspberrypi \
  ${BSPDIR}/meta-hackaton \
"
```

## yocto/meta-hackaton/conf/layer.conf
```bitbake
# We have a conf and classes directory, add to BBPATH
BBPATH .= ":${LAYERDIR}"

# We have recipes-* directories, add to BBFILES
BBFILES += "${LAYERDIR}/recipes-*/*/*.bb \
            ${LAYERDIR}/recipes-*/*/*.bbappend"

BBFILE_COLLECTIONS += "meta-hackaton"
BBFILE_PATTERN_meta-hackaton = "^${LAYERDIR}/"
BBFILE_PRIORITY_meta-hackaton = "10"

LAYERDEPENDS_meta-hackaton = "core"
LAYERSERIES_COMPAT_meta-hackaton = "kirkstone"
```

## yocto/meta-hackaton/conf/machine/hackaton.conf
```bitbake
MACHINEOVERRIDES =. "raspberrypi3-64:"

include conf/machine/raspberrypi3-64.conf

MACHINE_FEATURES:remove = " alsa bluetooth"
MACHINE_EXTRA_RRECOMMENDS = ""

RPI_KERNEL_DEVICETREE_OVERLAYS = " \
    overlays/mpu6050.dtbo \
    overlays/disable-bt.dtbo \
    "
    
RPI_KERNEL_DEVICETREE = " \
    broadcom/bcm2710-rpi-zero-2.dtb \
    "

DISABLE_SPLASH = "1"
BOOT_DELAY = "0"
BOOT_DELAY_MS = "0"
```
